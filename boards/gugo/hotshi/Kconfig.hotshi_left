## boards/gugo/hotshi/Kconfig.hotshi_left
```kconfig
config BOARD_HOTSHI_LEFT
    select SOC_NRF52840_QIAA
    imply RETAINED_MEM
    imply RETENTION
    imply RETENTION_BOOT_MODE
```

## boards/shields/hot_shi_48/Kconfig.defconfig
```kconfig
if SHIELD_HOT_SHI_48_LEFT

config ZMK_KEYBOARD_NAME
    default "hot-shi-48"

config ZMK_SPLIT_ROLE_CENTRAL
    default y

endif # SHIELD_HOT_SHI_48_LEFT

if SHIELD_HOT_SHI_48_LEFT || SHIELD_HOT_SHI_48_RIGHT

config ZMK_SPLIT
    default y

endif # SHIELD_HOT_SHI_48_LEFT || SHIELD_HOT_SHI_48_RIGHT
```

## boards/shields/hot_shi_48/Kconfig.shield
```kconfig
config SHIELD_HOT_SHI_48_LEFT
    def_bool $(shields_list_contains,hot_shi_48_left)

config SHIELD_HOT_SHI_48_RIGHT
    def_bool $(shields_list_contains,hot_shi_48_right)
```
